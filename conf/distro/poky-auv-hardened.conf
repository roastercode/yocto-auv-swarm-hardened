## conf/layer.conf
```bitbake
# yocto-auv-swarm-hardened layer configuration.
#
# This layer is a fork of yocto-jetson-tegra-hardened and replaces it in
# bblayers.conf: never load both.

BBPATH .= ":${LAYERDIR}"

BBFILES += "${LAYERDIR}/recipes-*/*/*.bb \
            ${LAYERDIR}/recipes-*/*/*.bbappend"

BBFILE_COLLECTIONS += "auv-swarm-hardened"
BBFILE_PATTERN_auv-swarm-hardened = "^${LAYERDIR}/"
BBFILE_PRIORITY_auv-swarm-hardened = "6"

LAYERVERSION_auv-swarm-hardened = "1"

LAYERDEPENDS_auv-swarm-hardened = " \
    core \
    openembedded-layer \
    networking-layer \
    meta-python \
    ros2-jazzy-layer \
    zenoh-layer \
"

LAYERSERIES_COMPAT_auv-swarm-hardened = "wrynose"
```
